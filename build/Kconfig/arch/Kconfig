## build/Kconfig/soc/Kconfig.soc
```kconfig
# Load SoC Kconfig descriptions.
osource "D:/zephyrproject/zephyr/soc/xlnx/zynqmp/Kconfig.soc"
osource "D:/zephyrproject/zephyr/soc/xlnx/zynq7000/Kconfig.soc"
osource "D:/zephyrproject/zephyr/soc/xen/Kconfig.soc"
osource "D:/zephyrproject/zephyr/soc/ti/simplelink/Kconfig.soc"
osource "D:/zephyrproject/zephyr/soc/ti/lm3s6965/Kconfig.soc"
osource "D:/zephyrproject/zephyr/soc/ti/k3/Kconfig.soc"
osource "D:/zephyrproject/zephyr/soc/telink/tlsr/Kconfig.soc"
osource "D:/zephyrproject/zephyr/soc/starfive/jh71xx/Kconfig.soc"
osource "D:/zephyrproject/zephyr/soc/st/stm32/Kconfig.soc"
osource "D:/zephyrproject/zephyr/soc/snps/qemu_arc/Kconfig.soc"
osource "D:/zephyrproject/zephyr/soc/snps/nsim/arc_v/Kconfig.soc"
osource "D:/zephyrproject/zephyr/soc/snps/nsim/arc_classic/Kconfig.soc"
osource "D:/zephyrproject/zephyr/soc/snps/hsdk4xd/Kconfig.soc"
osource "D:/zephyrproject/zephyr/soc/snps/hsdk/Kconfig.soc"
osource "D:/zephyrproject/zephyr/soc/snps/emsk/Kconfig.soc"
osource "D:/zephyrproject/zephyr/soc/snps/emsdp/Kconfig.soc"
osource "D:/zephyrproject/zephyr/soc/snps/arc_iot/Kconfig.soc"
osource "D:/zephyrproject/zephyr/soc/silabs/Kconfig.soc"
osource "D:/zephyrproject/zephyr/soc/sifive/sifive_freedom/Kconfig.soc"
osource "D:/zephyrproject/zephyr/soc/rockchip/Kconfig.soc"
osource "D:/zephyrproject/zephyr/soc/renode/riscv_virtual/Kconfig.soc"
osource "D:/zephyrproject/zephyr/soc/renesas/smartbond/Kconfig.soc"
osource "D:/zephyrproject/zephyr/soc/renesas/rzt2m/Kconfig.soc"
osource "D:/zephyrproject/zephyr/soc/renesas/rcar/Kconfig.soc"
osource "D:/zephyrproject/zephyr/soc/renesas/ra/Kconfig.soc"
osource "D:/zephyrproject/zephyr/soc/raspberrypi/Kconfig.soc"
osource "D:/zephyrproject/zephyr/soc/quicklogic/eos_s3/Kconfig.soc"
osource "D:/zephyrproject/zephyr/soc/qemu/virt_riscv/Kconfig.soc"
osource "D:/zephyrproject/zephyr/soc/qemu/malta/Kconfig.soc"
osource "D:/zephyrproject/zephyr/soc/openisa/rv32m1/Kconfig.soc"
osource "D:/zephyrproject/zephyr/soc/nxp/s32/Kconfig.soc"
osource "D:/zephyrproject/zephyr/soc/nxp/rw/Kconfig.soc"
osource "D:/zephyrproject/zephyr/soc/nxp/mcx/Kconfig.soc"
osource "D:/zephyrproject/zephyr/soc/nxp/lpc/Kconfig.soc"
osource "D:/zephyrproject/zephyr/soc/nxp/layerscape/Kconfig.soc"
osource "D:/zephyrproject/zephyr/soc/nxp/kinetis/Kconfig.soc"
osource "D:/zephyrproject/zephyr/soc/nxp/imxrt/Kconfig.soc"
osource "D:/zephyrproject/zephyr/soc/nxp/imx/Kconfig.soc"
osource "D:/zephyrproject/zephyr/soc/nuvoton/numicro/Kconfig.soc"
osource "D:/zephyrproject/zephyr/soc/nuvoton/numaker/Kconfig.soc"
osource "D:/zephyrproject/zephyr/soc/nuvoton/npcx/Kconfig.soc"
osource "D:/zephyrproject/zephyr/soc/nordic/Kconfig.soc"
osource "D:/zephyrproject/zephyr/soc/neorv32/Kconfig.soc"
osource "D:/zephyrproject/zephyr/soc/native/inf_clock/Kconfig.soc"
osource "D:/zephyrproject/zephyr/soc/microchip/miv/Kconfig.soc"
osource "D:/zephyrproject/zephyr/soc/microchip/mec/Kconfig.soc"
osource "D:/zephyrproject/zephyr/soc/mediatek/mtk_adsp/Kconfig.soc"
osource "D:/zephyrproject/zephyr/soc/lowrisc/opentitan/Kconfig.soc"
osource "D:/zephyrproject/zephyr/soc/litex/litex_vexriscv/Kconfig.soc"
osource "D:/zephyrproject/zephyr/soc/ite/ec/Kconfig.soc"
osource "D:/zephyrproject/zephyr/soc/intel/raptor_lake/Kconfig.soc"
osource "D:/zephyrproject/zephyr/soc/intel/lakemont/Kconfig.soc"
osource "D:/zephyrproject/zephyr/soc/intel/intel_socfpga_std/Kconfig.soc"
osource "D:/zephyrproject/zephyr/soc/intel/intel_socfpga/Kconfig.soc"
osource "D:/zephyrproject/zephyr/soc/intel/intel_niosv/Kconfig.soc"
osource "D:/zephyrproject/zephyr/soc/intel/intel_ish/Kconfig.soc"
osource "D:/zephyrproject/zephyr/soc/intel/intel_adsp/Kconfig.soc"
osource "D:/zephyrproject/zephyr/soc/intel/elkhart_lake/Kconfig.soc"
osource "D:/zephyrproject/zephyr/soc/intel/atom/Kconfig.soc"
osource "D:/zephyrproject/zephyr/soc/intel/apollo_lake/Kconfig.soc"
osource "D:/zephyrproject/zephyr/soc/intel/alder_lake/Kconfig.soc"
osource "D:/zephyrproject/zephyr/soc/infineon/cat3/Kconfig.soc"
osource "D:/zephyrproject/zephyr/soc/infineon/cat1b/Kconfig.soc"
osource "D:/zephyrproject/zephyr/soc/infineon/cat1a/Kconfig.soc"
osource "D:/zephyrproject/zephyr/soc/gd/gd32/Kconfig.soc"
osource "D:/zephyrproject/zephyr/soc/gaisler/leon3/Kconfig.soc"
osource "D:/zephyrproject/zephyr/soc/gaisler/gr716a/Kconfig.soc"
osource "D:/zephyrproject/zephyr/soc/espressif/Kconfig.soc"
osource "D:/zephyrproject/zephyr/soc/ene/kb1200/Kconfig.soc"
osource "D:/zephyrproject/zephyr/soc/efinix/sapphire/Kconfig.soc"
osource "D:/zephyrproject/zephyr/soc/cdns/xtensa_sample_controller/Kconfig.soc"
osource "D:/zephyrproject/zephyr/soc/cdns/dc233c/Kconfig.soc"
osource "D:/zephyrproject/zephyr/soc/brcm/bcmvk/Kconfig.soc"
osource "D:/zephyrproject/zephyr/soc/brcm/bcm2712/Kconfig.soc"
osource "D:/zephyrproject/zephyr/soc/brcm/bcm2711/Kconfig.soc"
osource "D:/zephyrproject/zephyr/soc/atmel/sam0/Kconfig.soc"
osource "D:/zephyrproject/zephyr/soc/atmel/sam/Kconfig.soc"
osource "D:/zephyrproject/zephyr/soc/aspeed/Kconfig.soc"
osource "D:/zephyrproject/zephyr/soc/arm/Kconfig.soc"
osource "D:/zephyrproject/zephyr/soc/arm/beetle/Kconfig.soc"
osource "D:/zephyrproject/zephyr/soc/andestech/Kconfig.soc"
osource "D:/zephyrproject/zephyr/soc/ambiq/Kconfig.soc"
osource "D:/zephyrproject/zephyr/soc/altr/zephyr_nios2f/Kconfig.soc"
osource "D:/zephyrproject/zephyr/soc/altr/qemu_nios2/Kconfig.soc"
osource "D:/zephyrproject/zephyr/soc/adi/max32/Kconfig.soc"
```
