## build/Kconfig/arch/Kconfig
```kconfig
# Load arch Kconfig descriptions.
osource "D:/zephyrproject/zephyr/arch/x86/Kconfig"
osource "D:/zephyrproject/zephyr/arch/xtensa/Kconfig"
osource "D:/zephyrproject/zephyr/arch/sparc/Kconfig"
osource "D:/zephyrproject/zephyr/arch/riscv/Kconfig"
osource "D:/zephyrproject/zephyr/arch/posix/Kconfig"
osource "D:/zephyrproject/zephyr/arch/nios2/Kconfig"
osource "D:/zephyrproject/zephyr/arch/mips/Kconfig"
osource "D:/zephyrproject/zephyr/arch/arm64/Kconfig"
osource "D:/zephyrproject/zephyr/arch/arm/Kconfig"
osource "D:/zephyrproject/zephyr/arch/arc/Kconfig"
```

## build/Kconfig/soc/Kconfig
```kconfig
# Load Zephyr SoC Kconfig descriptions.
osource "D:/zephyrproject/zephyr/soc/xlnx/zynqmp/Kconfig"
osource "D:/zephyrproject/zephyr/soc/xlnx/zynq7000/Kconfig"
osource "D:/zephyrproject/zephyr/soc/xen/Kconfig"
osource "D:/zephyrproject/zephyr/soc/ti/simplelink/Kconfig"
osource "D:/zephyrproject/zephyr/soc/ti/lm3s6965/Kconfig"
osource "D:/zephyrproject/zephyr/soc/ti/k3/Kconfig"
osource "D:/zephyrproject/zephyr/soc/telink/tlsr/Kconfig"
osource "D:/zephyrproject/zephyr/soc/starfive/jh71xx/Kconfig"
osource "D:/zephyrproject/zephyr/soc/st/stm32/Kconfig"
osource "D:/zephyrproject/zephyr/soc/snps/qemu_arc/Kconfig"
osource "D:/zephyrproject/zephyr/soc/snps/nsim/arc_v/Kconfig"
osource "D:/zephyrproject/zephyr/soc/snps/nsim/arc_classic/Kconfig"
osource "D:/zephyrproject/zephyr/soc/snps/hsdk4xd/Kconfig"
osource "D:/zephyrproject/zephyr/soc/snps/hsdk/Kconfig"
osource "D:/zephyrproject/zephyr/soc/snps/emsk/Kconfig"
osource "D:/zephyrproject/zephyr/soc/snps/emsdp/Kconfig"
osource "D:/zephyrproject/zephyr/soc/snps/arc_iot/Kconfig"
osource "D:/zephyrproject/zephyr/soc/silabs/Kconfig"
osource "D:/zephyrproject/zephyr/soc/sifive/sifive_freedom/Kconfig"
osource "D:/zephyrproject/zephyr/soc/rockchip/Kconfig"
osource "D:/zephyrproject/zephyr/soc/renode/riscv_virtual/Kconfig"
osource "D:/zephyrproject/zephyr/soc/renesas/smartbond/Kconfig"
osource "D:/zephyrproject/zephyr/soc/renesas/rzt2m/Kconfig"
osource "D:/zephyrproject/zephyr/soc/renesas/rcar/Kconfig"
osource "D:/zephyrproject/zephyr/soc/renesas/ra/Kconfig"
osource "D:/zephyrproject/zephyr/soc/raspberrypi/Kconfig"
osource "D:/zephyrproject/zephyr/soc/quicklogic/eos_s3/Kconfig"
osource "D:/zephyrproject/zephyr/soc/qemu/virt_riscv/Kconfig"
osource "D:/zephyrproject/zephyr/soc/qemu/malta/Kconfig"
osource "D:/zephyrproject/zephyr/soc/openisa/rv32m1/Kconfig"
osource "D:/zephyrproject/zephyr/soc/nxp/s32/Kconfig"
osource "D:/zephyrproject/zephyr/soc/nxp/rw/Kconfig"
osource "D:/zephyrproject/zephyr/soc/nxp/mcx/Kconfig"
osource "D:/zephyrproject/zephyr/soc/nxp/lpc/Kconfig"
osource "D:/zephyrproject/zephyr/soc/nxp/layerscape/Kconfig"
osource "D:/zephyrproject/zephyr/soc/nxp/kinetis/Kconfig"
osource "D:/zephyrproject/zephyr/soc/nxp/imxrt/Kconfig"
osource "D:/zephyrproject/zephyr/soc/nxp/imx/Kconfig"
osource "D:/zephyrproject/zephyr/soc/nuvoton/numicro/Kconfig"
osource "D:/zephyrproject/zephyr/soc/nuvoton/numaker/Kconfig"
osource "D:/zephyrproject/zephyr/soc/nuvoton/npcx/Kconfig"
osource "D:/zephyrproject/zephyr/soc/nordic/Kconfig"
osource "D:/zephyrproject/zephyr/soc/neorv32/Kconfig"
osource "D:/zephyrproject/zephyr/soc/native/inf_clock/Kconfig"
osource "D:/zephyrproject/zephyr/soc/microchip/miv/Kconfig"
osource "D:/zephyrproject/zephyr/soc/microchip/mec/Kconfig"
osource "D:/zephyrproject/zephyr/soc/mediatek/mtk_adsp/Kconfig"
osource "D:/zephyrproject/zephyr/soc/lowrisc/opentitan/Kconfig"
osource "D:/zephyrproject/zephyr/soc/litex/litex_vexriscv/Kconfig"
osource "D:/zephyrproject/zephyr/soc/ite/ec/Kconfig"
osource "D:/zephyrproject/zephyr/soc/intel/raptor_lake/Kconfig"
osource "D:/zephyrproject/zephyr/soc/intel/lakemont/Kconfig"
osource "D:/zephyrproject/zephyr/soc/intel/intel_socfpga_std/Kconfig"
osource "D:/zephyrproject/zephyr/soc/intel/intel_socfpga/Kconfig"
osource "D:/zephyrproject/zephyr/soc/intel/intel_niosv/Kconfig"
osource "D:/zephyrproject/zephyr/soc/intel/intel_ish/Kconfig"
osource "D:/zephyrproject/zephyr/soc/intel/intel_adsp/Kconfig"
osource "D:/zephyrproject/zephyr/soc/intel/elkhart_lake/Kconfig"
osource "D:/zephyrproject/zephyr/soc/intel/atom/Kconfig"
osource "D:/zephyrproject/zephyr/soc/intel/apollo_lake/Kconfig"
osource "D:/zephyrproject/zephyr/soc/intel/alder_lake/Kconfig"
osource "D:/zephyrproject/zephyr/soc/infineon/cat3/Kconfig"
osource "D:/zephyrproject/zephyr/soc/infineon/cat1b/Kconfig"
osource "D:/zephyrproject/zephyr/soc/infineon/cat1a/Kconfig"
osource "D:/zephyrproject/zephyr/soc/gd/gd32/Kconfig"
osource "D:/zephyrproject/zephyr/soc/gaisler/leon3/Kconfig"
osource "D:/zephyrproject/zephyr/soc/gaisler/gr716a/Kconfig"
osource "D:/zephyrproject/zephyr/soc/espressif/Kconfig"
osource "D:/zephyrproject/zephyr/soc/ene/kb1200/Kconfig"
osource "D:/zephyrproject/zephyr/soc/efinix/sapphire/Kconfig"
osource "D:/zephyrproject/zephyr/soc/cdns/xtensa_sample_controller/Kconfig"
osource "D:/zephyrproject/zephyr/soc/cdns/dc233c/Kconfig"
osource "D:/zephyrproject/zephyr/soc/brcm/bcmvk/Kconfig"
osource "D:/zephyrproject/zephyr/soc/brcm/bcm2712/Kconfig"
osource "D:/zephyrproject/zephyr/soc/brcm/bcm2711/Kconfig"
osource "D:/zephyrproject/zephyr/soc/atmel/sam0/Kconfig"
osource "D:/zephyrproject/zephyr/soc/atmel/sam/Kconfig"
osource "D:/zephyrproject/zephyr/soc/aspeed/Kconfig"
osource "D:/zephyrproject/zephyr/soc/arm/Kconfig"
osource "D:/zephyrproject/zephyr/soc/arm/beetle/Kconfig"
osource "D:/zephyrproject/zephyr/soc/andestech/Kconfig"
osource "D:/zephyrproject/zephyr/soc/ambiq/Kconfig"
osource "D:/zephyrproject/zephyr/soc/altr/zephyr_nios2f/Kconfig"
osource "D:/zephyrproject/zephyr/soc/altr/qemu_nios2/Kconfig"
osource "D:/zephyrproject/zephyr/soc/adi/max32/Kconfig"
```

## build/Kconfig/soc/Kconfig.defconfig
```kconfig
# Load Zephyr SoC Kconfig defconfig.
osource "D:/zephyrproject/zephyr/soc/xlnx/zynqmp/Kconfig.defconfig"
osource "D:/zephyrproject/zephyr/soc/xlnx/zynq7000/Kconfig.defconfig"
osource "D:/zephyrproject/zephyr/soc/xen/Kconfig.defconfig"
osource "D:/zephyrproject/zephyr/soc/ti/simplelink/Kconfig.defconfig"
osource "D:/zephyrproject/zephyr/soc/ti/lm3s6965/Kconfig.defconfig"
osource "D:/zephyrproject/zephyr/soc/ti/k3/Kconfig.defconfig"
osource "D:/zephyrproject/zephyr/soc/telink/tlsr/Kconfig.defconfig"
osource "D:/zephyrproject/zephyr/soc/starfive/jh71xx/Kconfig.defconfig"
osource "D:/zephyrproject/zephyr/soc/st/stm32/Kconfig.defconfig"
osource "D:/zephyrproject/zephyr/soc/snps/qemu_arc/Kconfig.defconfig"
osource "D:/zephyrproject/zephyr/soc/snps/nsim/arc_v/Kconfig.defconfig"
osource "D:/zephyrproject/zephyr/soc/snps/nsim/arc_classic/Kconfig.defconfig"
osource "D:/zephyrproject/zephyr/soc/snps/hsdk4xd/Kconfig.defconfig"
osource "D:/zephyrproject/zephyr/soc/snps/hsdk/Kconfig.defconfig"
osource "D:/zephyrproject/zephyr/soc/snps/emsk/Kconfig.defconfig"
osource "D:/zephyrproject/zephyr/soc/snps/emsdp/Kconfig.defconfig"
osource "D:/zephyrproject/zephyr/soc/snps/arc_iot/Kconfig.defconfig"
osource "D:/zephyrproject/zephyr/soc/silabs/Kconfig.defconfig"
osource "D:/zephyrproject/zephyr/soc/sifive/sifive_freedom/Kconfig.defconfig"
osource "D:/zephyrproject/zephyr/soc/rockchip/Kconfig.defconfig"
osource "D:/zephyrproject/zephyr/soc/renode/riscv_virtual/Kconfig.defconfig"
osource "D:/zephyrproject/zephyr/soc/renesas/smartbond/Kconfig.defconfig"
osource "D:/zephyrproject/zephyr/soc/renesas/rzt2m/Kconfig.defconfig"
osource "D:/zephyrproject/zephyr/soc/renesas/rcar/Kconfig.defconfig"
osource "D:/zephyrproject/zephyr/soc/renesas/ra/Kconfig.defconfig"
osource "D:/zephyrproject/zephyr/soc/raspberrypi/Kconfig.defconfig"
osource "D:/zephyrproject/zephyr/soc/quicklogic/eos_s3/Kconfig.defconfig"
osource "D:/zephyrproject/zephyr/soc/qemu/virt_riscv/Kconfig.defconfig"
osource "D:/zephyrproject/zephyr/soc/qemu/malta/Kconfig.defconfig"
osource "D:/zephyrproject/zephyr/soc/openisa/rv32m1/Kconfig.defconfig"
osource "D:/zephyrproject/zephyr/soc/nxp/s32/Kconfig.defconfig"
osource "D:/zephyrproject/zephyr/soc/nxp/rw/Kconfig.defconfig"
osource "D:/zephyrproject/zephyr/soc/nxp/mcx/Kconfig.defconfig"
osource "D:/zephyrproject/zephyr/soc/nxp/lpc/Kconfig.defconfig"
osource "D:/zephyrproject/zephyr/soc/nxp/layerscape/Kconfig.defconfig"
osource "D:/zephyrproject/zephyr/soc/nxp/kinetis/Kconfig.defconfig"
osource "D:/zephyrproject/zephyr/soc/nxp/imxrt/Kconfig.defconfig"
osource "D:/zephyrproject/zephyr/soc/nxp/imx/Kconfig.defconfig"
osource "D:/zephyrproject/zephyr/soc/nuvoton/numicro/Kconfig.defconfig"
osource "D:/zephyrproject/zephyr/soc/nuvoton/numaker/Kconfig.defconfig"
osource "D:/zephyrproject/zephyr/soc/nuvoton/npcx/Kconfig.defconfig"
osource "D:/zephyrproject/zephyr/soc/nordic/Kconfig.defconfig"
osource "D:/zephyrproject/zephyr/soc/neorv32/Kconfig.defconfig"
osource "D:/zephyrproject/zephyr/soc/native/inf_clock/Kconfig.defconfig"
osource "D:/zephyrproject/zephyr/soc/microchip/miv/Kconfig.defconfig"
osource "D:/zephyrproject/zephyr/soc/microchip/mec/Kconfig.defconfig"
osource "D:/zephyrproject/zephyr/soc/mediatek/mtk_adsp/Kconfig.defconfig"
osource "D:/zephyrproject/zephyr/soc/lowrisc/opentitan/Kconfig.defconfig"
osource "D:/zephyrproject/zephyr/soc/litex/litex_vexriscv/Kconfig.defconfig"
osource "D:/zephyrproject/zephyr/soc/ite/ec/Kconfig.defconfig"
osource "D:/zephyrproject/zephyr/soc/intel/raptor_lake/Kconfig.defconfig"
osource "D:/zephyrproject/zephyr/soc/intel/lakemont/Kconfig.defconfig"
osource "D:/zephyrproject/zephyr/soc/intel/intel_socfpga_std/Kconfig.defconfig"
osource "D:/zephyrproject/zephyr/soc/intel/intel_socfpga/Kconfig.defconfig"
osource "D:/zephyrproject/zephyr/soc/intel/intel_niosv/Kconfig.defconfig"
osource "D:/zephyrproject/zephyr/soc/intel/intel_ish/Kconfig.defconfig"
osource "D:/zephyrproject/zephyr/soc/intel/intel_adsp/Kconfig.defconfig"
osource "D:/zephyrproject/zephyr/soc/intel/elkhart_lake/Kconfig.defconfig"
osource "D:/zephyrproject/zephyr/soc/intel/atom/Kconfig.defconfig"
osource "D:/zephyrproject/zephyr/soc/intel/apollo_lake/Kconfig.defconfig"
osource "D:/zephyrproject/zephyr/soc/intel/alder_lake/Kconfig.defconfig"
osource "D:/zephyrproject/zephyr/soc/infineon/cat3/Kconfig.defconfig"
osource "D:/zephyrproject/zephyr/soc/infineon/cat1b/Kconfig.defconfig"
osource "D:/zephyrproject/zephyr/soc/infineon/cat1a/Kconfig.defconfig"
osource "D:/zephyrproject/zephyr/soc/gd/gd32/Kconfig.defconfig"
osource "D:/zephyrproject/zephyr/soc/gaisler/leon3/Kconfig.defconfig"
osource "D:/zephyrproject/zephyr/soc/gaisler/gr716a/Kconfig.defconfig"
osource "D:/zephyrproject/zephyr/soc/espressif/Kconfig.defconfig"
osource "D:/zephyrproject/zephyr/soc/ene/kb1200/Kconfig.defconfig"
osource "D:/zephyrproject/zephyr/soc/efinix/sapphire/Kconfig.defconfig"
osource "D:/zephyrproject/zephyr/soc/cdns/xtensa_sample_controller/Kconfig.defconfig"
osource "D:/zephyrproject/zephyr/soc/cdns/dc233c/Kconfig.defconfig"
osource "D:/zephyrproject/zephyr/soc/brcm/bcmvk/Kconfig.defconfig"
osource "D:/zephyrproject/zephyr/soc/brcm/bcm2712/Kconfig.defconfig"
osource "D:/zephyrproject/zephyr/soc/brcm/bcm2711/Kconfig.defconfig"
osource "D:/zephyrproject/zephyr/soc/atmel/sam0/Kconfig.defconfig"
osource "D:/zephyrproject/zephyr/soc/atmel/sam/Kconfig.defconfig"
osource "D:/zephyrproject/zephyr/soc/aspeed/Kconfig.defconfig"
osource "D:/zephyrproject/zephyr/soc/arm/Kconfig.defconfig"
osource "D:/zephyrproject/zephyr/soc/arm/beetle/Kconfig.defconfig"
osource "D:/zephyrproject/zephyr/soc/andestech/Kconfig.defconfig"
osource "D:/zephyrproject/zephyr/soc/ambiq/Kconfig.defconfig"
osource "D:/zephyrproject/zephyr/soc/altr/zephyr_nios2f/Kconfig.defconfig"
osource "D:/zephyrproject/zephyr/soc/altr/qemu_nios2/Kconfig.defconfig"
osource "D:/zephyrproject/zephyr/soc/adi/max32/Kconfig.defconfig"
```
